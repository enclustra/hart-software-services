## boards/me-mp1-250-ees-d3e/Kconfig
```kconfig
menu "Enclustra MP1 Design Configuration Options"

config SOC_FPGA_DESIGN_XML
	string "Enter path to Libero XML file"
	default "boards/$(BOARD)/soc_fpga_design/xml/mss_cfg.xml"
	help
		This option specifies the design XML file to use.
endmenu
```
